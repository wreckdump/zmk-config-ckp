## config/boards/polarityworks/bt60/Kconfig.bt60
```kconfig
# BT60 board configuration
# Copyright (c) 2021 Polarity Works
# SPDX-License-Identifier: MIT

config BOARD_BT60
	select SOC_NRF52840_QIAA
```

## config/boards/polarityworks/bt60/board.yml
```yaml
board:
  name: bt60
  vendor: polarityworks
  revision:
    format: major.minor.patch
    default: "2.0.0"
    exact: false
    revisions:
      - name: "2.0.0"
  socs:
    - name: nrf52840
```
